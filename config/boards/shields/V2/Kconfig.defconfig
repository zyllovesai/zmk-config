## config/boards/shields/V2/Kconfig.defconfig
```kconfig
if SHIELD_V2

config ZMK_KEYBOARD_NAME
    default "v2"

endif

if ZMK_DISPLAY

config I2C
    default y

config SSD1306
    default y

endif # ZMK_DISPLAY

if ZMK_RGB_UNDERGLOW

config WS2812_STRIP
    default y
endif
```

## config/boards/shields/cgsv2/Kconfig.defconfig
```kconfig
# Copyright (c) 2021 The ZMK Contributors
# SPDX-License-Identifier: MIT

if SHIELD_CGSV2_LEFT

config ZMK_KEYBOARD_NAME
    default "Cgsv2"

config ZMK_SPLIT_ROLE_CENTRAL
    default y

endif

if SHIELD_CGSV2_LEFT || SHIELD_CGSV2_RIGHT

config ZMK_SPLIT
    default y

endif
```

## config/boards/shields/cgsv2/Kconfig.shield
```kconfig
# Copyright (c) 2021 The ZMK Contributors
# SPDX-License-Identifier: MIT

config SHIELD_CGSV2_LEFT
    def_bool $(shields_list_contains,cgsv2_left)

config SHIELD_CGSV2_RIGHT
    def_bool $(shields_list_contains,cgsv2_right)
```

## config/boards/shields/e73test/Kconfig.defconfig
```kconfig
if SHIELD_E73Test

config ZMK_KEYBOARD_NAME
    default "e73test"

endif

if ZMK_DISPLAY

config I2C
    default y

config SSD1306
    default y

endif # ZMK_DISPLAY

if ZMK_RGB_UNDERGLOW

config WS2812_STRIP
    default y
endif
```

## config/boards/shields/v2/Kconfig.defconfig
```kconfig
# Copyright (c) 2020 Pete Johanson, Kurtis Lew
# SPDX-License-Identifier: MIT

if SHIELD_V2_LEFT

config ZMK_KEYBOARD_NAME
    default "v2"

config ZMK_SPLIT_ROLE_CENTRAL
    default y

endif

if SHIELD_V2_LEFT || SHIELD_V2_RIGHT

config ZMK_SPLIT
    default y

endif
```

## config/boards/shields/v2/Kconfig.shield
```kconfig
# Copyright (c) 2020 Pete Johanson, Kurtis Lew
# SPDX-License-Identifier: MIT

config SHIELD_V2_LEFT
    def_bool $(shields_list_contains,v2_left)

config SHIELD_V2_RIGHT
    def_bool $(shields_list_contains,v2_right)
```

## config/boards/shields/ZYL87K/Kconfig.defconfig
```kconfig
if SHIELD_ZYL87K

config ZMK_KEYBOARD_NAME
    default "ZYL87K"

endif

if ZMK_RGB_UNDERGLOW

config WS2812_STRIP
    default y
endif
```

## config/boards/shields/circular58az/Kconfig.defconfig
```kconfig
if SHIELD_Circular58AZ

config ZMK_KEYBOARD_NAME
    default "circular58az"

endif
```

## config/boards/shields/cnc_v1/Kconfig.defconfig
```kconfig
# Copyright (c) 2020 The ZMK Contributors
# SPDX-License-Identifier: MIT

if SHIELD_CNC

config ZMK_KEYBOARD_NAME
    default "cnc"

endif
```

## config/boards/shields/cnc_v1/Kconfig.shield
```kconfig
# Copyright (c) 2020 The ZMK Contributors
# SPDX-License-Identifier: MIT

config SHIELD_CNC
    def_bool $(shields_list_contains,cnc)
```
